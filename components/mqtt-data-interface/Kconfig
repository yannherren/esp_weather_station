## components/mqtt-data-interface/Kconfig
```kconfig
menu "MQTT Client Config"

    config MQTT_BROKER_URI
        string "MQTT broker URI"
        default ""
        help
            MQTT Broker URI

    config MQTT_USER
        string "MQTT user"
        default ""
        help
            MQTT user

    config MQTT_CLIENT_ID
        string "MQTT client id"
        default ""
        help
            MQTT client id

    config MQTT_PASSWORD
        string "MQTT password"
        default ""
        help
            MQTT password

endmenu
```

## components/power-management/Kconfig
```kconfig
menu "Power Management Config"

    config POWER_MANAGEMENT_SLEEP_INTERVAL
        int "Sleep interval (seconds)"
        default 3600
        help
            Go to deep sleep for the defined amount of seconds

endmenu
```

## components/wifi/Kconfig
```kconfig
menu "Wifi Wrapper Config"

    config WIFI_WRAPPER_SSID
        string "SSID"
        default ""
        help
            WIFI SSID to connect to

    config WIFI_WRAPPER_PASSWORD
        string "Password"
        default ""
        help
            Password for the WIFI connection

endmenu
```
